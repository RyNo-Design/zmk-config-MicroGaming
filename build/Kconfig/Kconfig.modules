## build/Kconfig/Kconfig.modules
```kconfig
menu "nanopb (/workspaces/zmk-config-MicroGaming/modules/lib/nanopb)"
osource "$(ZEPHYR_NANOPB_KCONFIG)"
config ZEPHYR_NANOPB_MODULE
	bool
	default y
endmenu
menu "acpica (/workspaces/zmk-config-MicroGaming/modules/lib/acpica)"
osource "$(ZEPHYR_ACPICA_KCONFIG)"
config ZEPHYR_ACPICA_MODULE
	bool
	default y
endmenu
menu "canopennode (/workspaces/zmk-config-MicroGaming/modules/lib/canopennode)"
osource "$(ZEPHYR_CANOPENNODE_KCONFIG)"
config ZEPHYR_CANOPENNODE_MODULE
	bool
	default y
endmenu
menu "cmsis (/workspaces/zmk-config-MicroGaming/modules/hal/cmsis)"
osource "$(ZEPHYR_CMSIS_KCONFIG)"
config ZEPHYR_CMSIS_MODULE
	bool
	default y
endmenu
menu "cmsis-dsp (/workspaces/zmk-config-MicroGaming/modules/lib/cmsis-dsp)"
osource "$(ZEPHYR_CMSIS_DSP_KCONFIG)"
config ZEPHYR_CMSIS_DSP_MODULE
	bool
	default y
endmenu
menu "cmsis-nn (/workspaces/zmk-config-MicroGaming/modules/lib/cmsis-nn)"
osource "$(ZEPHYR_CMSIS_NN_KCONFIG)"
config ZEPHYR_CMSIS_NN_MODULE
	bool
	default y
endmenu
menu "fatfs (/workspaces/zmk-config-MicroGaming/modules/fs/fatfs)"
osource "$(ZEPHYR_FATFS_KCONFIG)"
config ZEPHYR_FATFS_MODULE
	bool
	default y
endmenu
menu "hal_ambiq (/workspaces/zmk-config-MicroGaming/modules/hal/ambiq)"
osource "$(ZEPHYR_HAL_AMBIQ_KCONFIG)"
config ZEPHYR_HAL_AMBIQ_MODULE
	bool
	default y
endmenu
menu "hal_espressif (/workspaces/zmk-config-MicroGaming/modules/hal/espressif)"
osource "/workspaces/zmk-config-MicroGaming/modules/hal/espressif/zephyr/Kconfig"
config ZEPHYR_HAL_ESPRESSIF_MODULE
	bool
	default y
endmenu
menu "hal_ethos_u (/workspaces/zmk-config-MicroGaming/modules/hal/ethos_u)"
osource "$(ZEPHYR_HAL_ETHOS_U_KCONFIG)"
config ZEPHYR_HAL_ETHOS_U_MODULE
	bool
	default y
endmenu
menu "hal_gigadevice (/workspaces/zmk-config-MicroGaming/modules/hal/gigadevice)"
osource "$(ZEPHYR_HAL_GIGADEVICE_KCONFIG)"
config ZEPHYR_HAL_GIGADEVICE_MODULE
	bool
	default y
endmenu
menu "hal_nordic (/workspaces/zmk-config-MicroGaming/modules/hal/nordic)"
osource "$(ZEPHYR_HAL_NORDIC_KCONFIG)"
config ZEPHYR_HAL_NORDIC_MODULE
	bool
	default y
endmenu
menu "hal_rpi_pico (/workspaces/zmk-config-MicroGaming/modules/hal/rpi_pico)"
osource "$(ZEPHYR_HAL_RPI_PICO_KCONFIG)"
config ZEPHYR_HAL_RPI_PICO_MODULE
	bool
	default y
endmenu
menu "hal_telink (/workspaces/zmk-config-MicroGaming/modules/hal/telink)"
osource "/workspaces/zmk-config-MicroGaming/modules/hal/telink/Kconfig"
config ZEPHYR_HAL_TELINK_MODULE
	bool
	default y
endmenu
menu "liblc3 (/workspaces/zmk-config-MicroGaming/modules/lib/liblc3)"
osource "$(ZEPHYR_LIBLC3_KCONFIG)"
config ZEPHYR_LIBLC3_MODULE
	bool
	default y
endmenu
menu "littlefs (/workspaces/zmk-config-MicroGaming/modules/fs/littlefs)"
osource "$(ZEPHYR_LITTLEFS_KCONFIG)"
config ZEPHYR_LITTLEFS_MODULE
	bool
	default y
endmenu
menu "lvgl (/workspaces/zmk-config-MicroGaming/modules/lib/gui/lvgl)"
osource "/workspaces/zmk-config-MicroGaming/modules/lib/gui/lvgl/Kconfig"
config ZEPHYR_LVGL_MODULE
	bool
	default y
endmenu
menu "mbedtls (/workspaces/zmk-config-MicroGaming/modules/crypto/mbedtls)"
osource "$(ZEPHYR_MBEDTLS_KCONFIG)"
config ZEPHYR_MBEDTLS_MODULE
	bool
	default y
endmenu
menu "percepio (/workspaces/zmk-config-MicroGaming/modules/debug/percepio)"
osource "/workspaces/zmk-config-MicroGaming/modules/debug/percepio/zephyr/Kconfig"
config ZEPHYR_PERCEPIO_MODULE
	bool
	default y
endmenu
menu "picolibc (/workspaces/zmk-config-MicroGaming/modules/lib/picolibc)"
osource "/workspaces/zmk-config-MicroGaming/modules/lib/picolibc/zephyr/Kconfig"
config ZEPHYR_PICOLIBC_MODULE
	bool
	default y
endmenu
menu "segger (/workspaces/zmk-config-MicroGaming/modules/debug/segger)"
osource "$(ZEPHYR_SEGGER_KCONFIG)"
config ZEPHYR_SEGGER_MODULE
	bool
	default y
endmenu
menu "trusted-firmware-a (/workspaces/zmk-config-MicroGaming/modules/tee/tf-a/trusted-firmware-a)"
osource "$(ZEPHYR_TRUSTED_FIRMWARE_A_KCONFIG)"
config ZEPHYR_TRUSTED_FIRMWARE_A_MODULE
	bool
	default y
endmenu
menu "uoscore-uedhoc (/workspaces/zmk-config-MicroGaming/modules/lib/uoscore-uedhoc)"
osource "$(ZEPHYR_UOSCORE_UEDHOC_KCONFIG)"
config ZEPHYR_UOSCORE_UEDHOC_MODULE
	bool
	default y
endmenu
menu "zcbor (/workspaces/zmk-config-MicroGaming/modules/lib/zcbor)"
osource "$(ZEPHYR_ZCBOR_KCONFIG)"
config ZEPHYR_ZCBOR_MODULE
	bool
	default y
endmenu
menu "module (/workspaces/zmk-config-MicroGaming/zmk/app/module)"
osource "/workspaces/zmk-config-MicroGaming/zmk/app/module/Kconfig"
config ZEPHYR_MODULE_MODULE
	bool
	default y
endmenu
```

## config/boards/shields/MicroGaming/kconfig.defconfig
```kconfig
if SHIELD_HUMMINGBIRD
            
config ZMK_KEYBOARD_NAME
    default "MicroGaming"

endif
```

## config/boards/shields/hummingbird/Kconfig
```kconfig
config SHIELD_MICROGAMING_SINGLE
    bool "MicroGaming Single Shield"
    default y
    help
        Custom shield for a non-split keyboard using Nice!Nano V2.
```

## config/boards/shields/hummingbird/kconfig.defconfig
```kconfig
if SHIELD_PRO_MICRO
            
config ZMK_KEYBOARD_NAME
    default "MicroGaming"

endif
```

## config/boards/shields/microgaming_single/kconfig.defconfig
```kconfig
if SHIELD_MICROGAMING_SINGLE

config ZMK_KEYBOARD_NAME
    default "Microgaming Single"

endif
```

## config/shields/MicroGaming/west.yml
```yaml
manifest:
  remotes:
    - name: zmkfirmware
      url-base: https://github.com/zmkfirmware

  projects:
    - name: zmk
      remote: zmkfirmwarerm -rf /workspaces/zmk-config-MicroGaming/
      import: app/west.yml

  self:
    path: config
```

## config/west.yml
```yaml
manifest:
  remotes:
    - name: zmkfirmware
      url-base: https://github.com/zmkfirmware

  projects:
    - name: hummingbird
      remote: zmkfirmware
      revision: main
      import: app/west.yml

  self:
    path: config/modules/hummingbird
```
